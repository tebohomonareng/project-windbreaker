#include "display/display.h"
#include "config.h"
#include "joystick/joystick.h"
#include "attack/attack.h"
#include "attack/sniffer.h"
#include "ui/menu.h"
#include <SPI.h>
#include <Adafruit_GFX.h>
#include <Adafruit_SSD1306.h>
#include <WiFi.h>
#include <time.h>
#include <algorithm>
#include <cstdio>

// Grid layout constants
#define HEADER_H   12
#define GRID_COLS  2
#define GRID_ROWS  2
#define CELL_W     64                        // 128 / 2
#define CELL_H     26                        // (64 - 12) / 2
#define GRID_START (HEADER_H)

// Text rendering optimization
#define CHAR_WIDTH 6
#define CHAR_HEIGHT 8
#define MENU_ITEM_HEIGHT 10
#define MENU_START_Y 14

// Menu items
struct MenuItem {
    const char* label;
    const char* icon; // Simple text icon, replace with bitmap later
};

static const MenuItem menuItems[MENU_ITEM_COUNT] = {
    { "WiFi", "W" },
    { "Settings", "S"},
    { "Info", "I"}
};

const unsigned char myLogo[] PROGMEM = {
    0x00, 0x00 // Replace with your generated bytes from image2cpp
};

static Adafruit_SSD1306 display(128, 64, &SPI, OLED_DC, OLED_RESET, OLED_CS);

// Helper function: Get battery percentage (placeholder for real implementation)
 int getBatteryPercent() {
    // TODO: Implement real battery reading
    // For now, return a fixed value
    return 100;
}

// Helper function: Draw a generic submenu with title and items
static void drawGenericSubmenu(const char* title, const char* items[], int item_count, int selected) {
    display.clearDisplay();
    display.setTextColor(SSD1306_WHITE);
    display.setTextSize(1);
    
    // Header
    display.drawFastHLine(0, 10, 128, SSD1306_WHITE);
    display.setCursor(0, 2);
    display.println(title);
    
    // Display items as vertical list
    for (int i = 0; i < item_count; i++) {
        int y = MENU_START_Y + (i * MENU_ITEM_HEIGHT);
        display.setCursor(2, y);
        
        if (i == selected) {
            display.fillRect(0, y - 1, 128, 9, SSD1306_WHITE);
            display.setTextColor(SSD1306_BLACK);
            display.print(">> ");
        } else {
            display.setTextColor(SSD1306_WHITE);
            display.print("   ");
        }
        
        display.println(items[i]);
    }
    
    display.setTextColor(SSD1306_WHITE);
    display.display();
}

void initDisplay() {
    SPI.begin(18, 19, 23, OLED_CS);

    if (!display.begin(SSD1306_SWITCHCAPVCC)) {
        Serial.println("SSD1306 failed");
        for(;;);
    }

    display.setTextColor(SSD1306_WHITE);
    display.setTextSize(1);
}

void showLogo() {
    display.clearDisplay();
    display.drawBitmap(0, 0, myLogo, 128, 64, SSD1306_WHITE);
    display.display();
    delay(2000);
}

void drawWiFiIcon(int x, int y, int strength) {
    display.fillCircle(x, y, 1, SSD1306_WHITE);

    if (strength >= 1) {
        display.drawPixel(x-1, y-1, SSD1306_WHITE);
        display.drawPixel(x+1, y-1, SSD1306_WHITE);
        display.drawPixel(x-2, y-2, SSD1306_WHITE);
        display.drawPixel(x+2, y-2, SSD1306_WHITE);
    }
    if (strength >= 2) {
        display.drawPixel(x-2, y-3, SSD1306_WHITE);
        display.drawPixel(x+2, y-3, SSD1306_WHITE);
        display.drawPixel(x-3, y-4, SSD1306_WHITE);
        display.drawPixel(x+3, y-4, SSD1306_WHITE);
        display.drawPixel(x-4, y-5, SSD1306_WHITE);
        display.drawPixel(x+4, y-5, SSD1306_WHITE);
    }
    if (strength >= 3) {
        display.drawPixel(x-4, y-6, SSD1306_WHITE);
        display.drawPixel(x+4, y-6, SSD1306_WHITE);
        display.drawPixel(x-5, y-7, SSD1306_WHITE);
        display.drawPixel(x+5, y-7, SSD1306_WHITE);
        display.drawPixel(x-6, y-8, SSD1306_WHITE);
        display.drawPixel(x+6, y-8, SSD1306_WHITE);
    }
    if (strength >= 4) {
        display.drawPixel(x-6, y-9,  SSD1306_WHITE);
        display.drawPixel(x+6, y-9,  SSD1306_WHITE);
        display.drawPixel(x-7, y-10, SSD1306_WHITE);
        display.drawPixel(x+7, y-10, SSD1306_WHITE);
        display.drawPixel(x-8, y-11, SSD1306_WHITE);
        display.drawPixel(x+8, y-11, SSD1306_WHITE);
    }
}

void drawGridCell(int index, int selected) {
    int col = index % GRID_COLS;
    int row = index / GRID_COLS;

    int x = col * CELL_W;
    int y = GRID_START + (row * CELL_H);

    bool isSelected = (index == selected);

    // Draw cell background
    if (isSelected) {
        display.fillRect(x, y, CELL_W, CELL_H, SSD1306_WHITE);
        display.setTextColor(SSD1306_BLACK);
    } else {
        display.drawRect(x, y, CELL_W, CELL_H, SSD1306_WHITE);
        display.setTextColor(SSD1306_WHITE);
    }

    // Draw icon (centered horizontally, upper portion of cell)
    display.setCursor(x + (CELL_W / 2) - 3, y + 6);
    display.print(menuItems[index].icon);

    // Draw label (centered horizontally, lower portion of cell)
    const char* label = menuItems[index].label;
    int labelLen = strlen(label) * CHAR_WIDTH;
    display.setCursor(x + (CELL_W / 2) - (labelLen / 2), y + 16);
    display.print(label);

    // Reset text color only if needed
    if (isSelected) {
        display.setTextColor(SSD1306_WHITE);
    }
}

void drawHomeMenu() {
    display.clearDisplay();
    display.setTextColor(SSD1306_WHITE);
    display.setTextSize(1);

    // Header line
    display.drawFastHLine(0, HEADER_H, 128, SSD1306_WHITE);

    // WiFi indicator
    if (WiFi.status() == WL_CONNECTED) {
        int rssi = WiFi.RSSI();
        int strength;
        if (rssi >= -50)      strength = 4;
        else if (rssi >= -60) strength = 3;
        else if (rssi >= -70) strength = 2;
        else                  strength = 1;
        drawWiFiIcon(10, 10, strength);
    } else {
        display.setCursor(6, 2);
        display.print("X");
    }

    // Time
    display.setCursor(50, 2);
    time_t now = time(nullptr);
    if (now > 1577836800) {
        struct tm* timeinfo = localtime(&now);
        char time_str[6];
        strftime(time_str, sizeof(time_str), "%H:%M", timeinfo);
        display.print(time_str);
    } else {
        display.print("--:--");
    }

    // Battery (now dynamic instead of hardcoded)
    display.setCursor(95, 2);
    char battery_str[5];
    snprintf(battery_str, sizeof(battery_str), "%d%%", getBatteryPercent());
    display.print(battery_str);

    // Draw grid cells (2x2)
    HomeMenuItem selected = getCurrentHomeItem();
    for (int i = 0; i < HOME_SUBMENU_COUNT; i++) {
        drawGridCell(i, (int)selected);
    }

    display.display();
}

void drawScanResults() {
    display.clearDisplay();
    display.setTextColor(SSD1306_WHITE);
    display.setTextSize(1);
    
    // Header
    display.setCursor(0, 0);
    display.println("[NETWORK SCAN]");
    display.drawFastHLine(0, 10, 128, SSD1306_WHITE);
    
    // Check scan status
    int16_t scan_count = WiFi.scanComplete();
    
    display.setCursor(0, 15);
    
    if (scan_count == WIFI_SCAN_RUNNING) {
        display.println("Scanning...");
        display.println("");
        display.println("Please wait");
    } else if (scan_count <= 0) {
        display.println("No networks found");
        display.println("");
        display.println("Press button to");
        display.println("scan again");
    } else {
        // Show network count and info
        char count_str[20];
        snprintf(count_str, sizeof(count_str), "Networks: %d", scan_count);
        display.println(count_str);
        display.println("");
        
        // Show first 3 networks
        int show_count = (scan_count < 3) ? scan_count : 3;
        char network_str[25];
        for (int i = 0; i < show_count; i++) {
            String ssid = WiFi.SSID(i);
            int rssi = WiFi.RSSI(i);
            
            // Truncate SSID if too long
            if (ssid.length() > 12) {
                ssid = ssid.substring(0, 12);
            }
            
            snprintf(network_str, sizeof(network_str), "%d. %s (%d)", 
                     i + 1, ssid.c_str(), rssi);
            display.println(network_str);
        }
    }
    
    display.display();
}

void drawWiFiSubmenu() {
    const char* wifiItems[] = {
        "Scan Networks",
        "Deauth Attack",
        "Beacon Spoof",
        "Packet Stats",
        "EXIT"
    };
    drawGenericSubmenu("[WiFi]", wifiItems, WIFI_SUBMENU_COUNT, getCurrentWiFiItem());
}

void drawSettingsMenu() {
    const char* settingsItems[] = {
        "Channel",
        "Power",
        "Brightness",
        "EXIT"
    };
    drawGenericSubmenu("[Settings]", settingsItems, SETTINGS_SUBMENU_COUNT, getCurrentSettingsItem());
}

void drawInfoMenu() {
    const char* infoItems[] = {
        "Device Info",
        "Status",
        "MAC Addr",
        "EXIT"
    };
    drawGenericSubmenu("[Info]", infoItems, INFO_SUBMENU_COUNT, getCurrentInfoItem());
}




void drawPacketStats() {
    display.clearDisplay();
    display.setTextColor(SSD1306_WHITE);
    display.setTextSize(1);
    
    // Header
    display.setCursor(0, 0);
    display.println("[PACKET STATS]");
    display.drawFastHLine(0, 10, 128, SSD1306_WHITE);
    
    display.setCursor(0, 15);
    
    // Use formatted strings instead of String concatenation for efficiency
    char stat_str[20];
    
    snprintf(stat_str, sizeof(stat_str), "Total: %u", getTotalPacketCount());
    display.println(stat_str);
    
    snprintf(stat_str, sizeof(stat_str), "Beacons: %u", getPacketCount(PACKET_TYPE_BEACON));
    display.println(stat_str);
    
    snprintf(stat_str, sizeof(stat_str), "Deauth: %u", getPacketCount(PACKET_TYPE_DEAUTH));
    display.println(stat_str);
    
    snprintf(stat_str, sizeof(stat_str), "Data: %u", getPacketCount(PACKET_TYPE_DATA));
    display.println(stat_str);
    
    display.display();
}